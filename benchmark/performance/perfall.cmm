;**************************************************************************************
; 
;  NXP(TM) and the NXP logo are trademarks of NXP. 
;  All other product or service names are the property of their respective owners. 
;  (c) Copyright 2012 - 2016 Freescale Semiconductor Inc.
;  Copyright 2017 NXP
;  All Rights Reserved.
; 
;  You can use this example for any purpose on any computer system with the
;  following restrictions:
;
;  1. This example is provided "as is", without warranty.
;
;  2. You don't remove this copyright notice from this example or any direct derivation 
;     thereof.
;
;   Description: This Lauterbach script performs all performance tests
;
; **************************************************************************

cd bcc1
DO pbcc1.cmm
cd ..

cd ecc1
DO pecc1.cmm
cd ..\

