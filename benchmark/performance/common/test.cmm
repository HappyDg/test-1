;**************************************************************************************
; 
;  NXP(TM) and the NXP logo are trademarks of NXP. 
;  All other product or service names are the property of their respective owners. 
;  (c) Copyright 2012 - 2016 Freescale Semiconductor Inc.
;  Copyright 2017 NXP
;  All Rights Reserved.
; 
;  You can use this example for any purpose on any computer system with the
;  following restrictions:
;
;  1. This example is provided "as is", without warranty.
;
;  2. You don't remove this copyright notice from this example or any direct derivation 
;     thereof.
;
;   Description: It is common part of lauterbach script for each test 
;
; **************************************************************************

GLOBAL &def_suff
ENTRY  &CLASS &SC
LOCAL &target

&suff="_gh"
IF ("&def_suff"!="")
    &suff="&def_suff"


&elf="bin/p&CLASS&SC&suff&target.elf"
&log="bin/p&CLASS&SC&suff&target.csv"

TITLE "Performance test for &SC/&CLASS"
RESET

DO ..\..\..\common\s32k.cmm &elf

DATA.LIST
SYMBOL.BROWSE.FUNCTION
WAIT 1s
BREAK.RESET
;BREAK.SET SetPLL
GO
WAIT !run() 10.s
BREAK
DO ..\log.cmm &SC &log


