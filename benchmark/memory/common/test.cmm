;**************************************************************************************
; 
;  NXP(TM) and the NXP logo are trademarks of NXP. 
;  All other product or service names are the property of their respective owners. 
;  (c) Copyright 2012 - 2016 Freescale Semiconductor Inc.
;  Copyright 2017 NXP
;  All Rights Reserved.
; 
;  You can use this example for any purpose on any computer system with the
;  following restrictions:
;
;  1. This example is provided "as is", without warranty.
;
;  2. You don't remove this copyright notice from this example or any direct derivation 
;     thereof.
;
;  Description:  Common part of Lauterbach script for each memory benchmark
;
;**************************************************************************************

GLOBAL &def_suff
LOCAL &tname &cname &target
ENTRY &tname &cname

&suff="_gh"

IF ("&def_suff"!="")
    &suff="&def_suff"

    
&elf="bin/m&tname&cname&suff&target.elf"  
    
TITLE "Memory benchmark for " &tname " " &cname
RESET 

DO ..\..\..\common\s32k.cmm &elf

DATA.LIST 
WAIT 1s
BREAK.RESET
BREAK.SET EndMeasurement
GO
WAIT !run() 15.s
DO ..\..\common\log.cmm &tname &cname &suff &target
