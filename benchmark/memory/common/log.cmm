;**************************************************************************************
; 
;  NXP(TM) and the NXP logo are trademarks of NXP.
;  All other product or service names are the property of their respective owners. 
;  (c) Copyright 2012 - 2016 Freescale Semiconductor Inc.
;  Copyright 2017 NXP
;  All Rights Reserved.
; 
;  You can use this example for any purpose on any computer system with the
;  following restrictions:
;
;  1. This example is provided "as is", without warranty.
;
;  2. You don't remove this copyright notice from this example or any direct derivation 
;     thereof.
;
;  Description: This Lauterbach script prints log of memory benchmark
;
;**************************************************************************************

LOCAL &tname &cname &suff &target
ENTRY &tname &cname &suff &target

OPEN #1 bin/m&tname&cname&suff&target.log /Create
CLOSE #1
APPEND bin/m&tname&cname&suff&target.log "==================="
APPEND bin/m&tname&cname&suff&target.log "TEST : " &tname " for " &cname
APPEND bin/m&tname&cname&suff&target.log "==================="
APPEND bin/m&tname&cname&suff&target.log "sysCnt   =	" %DECIMAL DATA.LONG(sysCnt)
APPEND bin/m&tname&cname&suff&target.log "nosys    =	" %DECIMAL DATA.LONG(nosys)
APPEND bin/m&tname&cname&suff&target.log "Overhead =	" DATA.WORD(procent)/100.0 "%"
APPEND bin/m&tname&cname&suff&target.log "-------------------"

IF (&tname=="bcc1")
(
 IF (&cname=="sc1")
 (
   APPEND bin/m&tname&cname&suff&target.log "Main stack usage          =	" %DECIMAL DATA.LONG(stackUsage)
 )
 ELSE
 (
   APPEND bin/m&tname&cname&suff&target.log "Common stack usage        =	" %DECIMAL DATA.LONG(stackUsage)
   APPEND bin/m&tname&cname&suff&target.log "System Timer stack usage  =	" %DECIMAL DATA.LONG(stackUsage+04)
 )  
)
IF (&tname=="ecc1")
(
 IF (&cname=="sc1")
 (
   APPEND bin/m&tname&cname&suff&target.log "Main stack usage         =	" %DECIMAL DATA.LONG(stackUsage)
 )
 ELSE
 (
   APPEND bin/m&tname&cname&suff&target.log "Common stack usage       =	" %DECIMAL DATA.LONG(stackUsage) 
 )
 APPEND bin/m&tname&cname&suff&target.log "Task1 stack usage        =	" %DECIMAL DATA.LONG(stackUsage+04)
 APPEND bin/m&tname&cname&suff&target.log "Task2 stack usage        =	" %DECIMAL DATA.LONG(stackUsage+08)
 APPEND bin/m&tname&cname&suff&target.log "Task3 stack usage        =	" %DECIMAL DATA.LONG(stackUsage+0C)
 APPEND bin/m&tname&cname&suff&target.log "Task4 stack usage        =	" %DECIMAL DATA.LONG(stackUsage+10)
 APPEND bin/m&tname&cname&suff&target.log "Task5 stack usage        =	" %DECIMAL DATA.LONG(stackUsage+14)
 APPEND bin/m&tname&cname&suff&target.log "Task6 stack usage        =	" %DECIMAL DATA.LONG(stackUsage+18)
 APPEND bin/m&tname&cname&suff&target.log "Task7 stack usage        =	" %DECIMAL DATA.LONG(stackUsage+1C)
 APPEND bin/m&tname&cname&suff&target.log "Task8 stack usage        =	" %DECIMAL DATA.LONG(stackUsage+20)
 APPEND bin/m&tname&cname&suff&target.log "Task9 stack usage        =	" %DECIMAL DATA.LONG(stackUsage+24)
 APPEND bin/m&tname&cname&suff&target.log "Task10 stack usage       =	" %DECIMAL DATA.LONG(stackUsage+28)
 IF (&cname=="sc1")
 (
   APPEND bin/m&tname&cname&suff&target.log "ISR stack usage        =	" %DECIMAL DATA.LONG(stackUsage+2C)
 )
 ELSE
 (
   IF (&cname=="sc2")
   (
     APPEND bin/m&tname&cname&suff&target.log "ISR stack usage          =	" %DECIMAL DATA.LONG(stackUsage+2C)
   )
   ELSE
   (
     APPEND bin/m&tname&cname&suff&target.log "System Timer stack usage =	" %DECIMAL DATA.LONG(stackUsage+2C)
   )
 )
) 

APPEND bin/m&tname&cname&suff&target.log "==================="

TYPE bin/m&tname&cname&suff&target.log

