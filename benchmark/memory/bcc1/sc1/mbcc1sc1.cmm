;**************************************************************************************
; 
;  NXP(TM) and the NXP logo are trademarks of NXP.  
;  All other product or service names are the property of their respective owners. 
;  (c) Copyright 2012 - 2016 Freescale Semiconductor Inc.
;  Copyright 2017 NXP
;  All Rights Reserved.
; 
;  You can use this example for any purpose on any computer system with the
;  following restrictions:
;
;  1. This example is provided "as is", without warranty.
;
;  2. You don't remove this copyright notice from this example or any direct derivation 
;     thereof.
;
;  Description:  The Lauterbach script for BCC1/SC1 memory benchmark
;
;**************************************************************************************

DO ..\..\common\test.cmm "bcc1" "sc1"
